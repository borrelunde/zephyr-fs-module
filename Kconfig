## Kconfig
```kconfig
config FS_MODULE
	bool "FS module support"
	default n
	help
		This option enables FS module.
```

## west.yml
```yaml
manifest:
  version: 0.7

  self:
    # Where this repository should be cloned to.
    path: fs-module
```
